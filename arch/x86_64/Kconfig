## arch/x86_64/Kconfig
```kconfig
#
# For a description of the syntax of this configuration file,
# see the file kconfig-language.txt in the NuttX tools repository.
#

if ARCH_X86_64
comment "x86_64 Configuration Options"

choice
	prompt "x86_64 chip selection"
	default ARCH_INTEL64

config ARCH_INTEL64
	bool "intel64"
	select ARCH_X86_HAVE_64BIT
	---help---
		Intel x86_64 architecture

endchoice

config ARCH_CHIP_QEMU
	bool "Qemu x86_64 emulation"
	default n
	---help---
		Intel intel64 architecture

config ARCH_CHIP
	string
	default "qemu" if ARCH_CHIP_QEMU

config ARCH_X86_HAVE_64BIT
	bool
	default n

source arch/x86_64/src/common/Kconfig
if ARCH_INTEL64
source arch/x86_64/src/intel64/Kconfig
endif # ARCH_INTEL64
if ARCH_CHIP_QEMU
source arch/x86/src/qemu/Kconfig
endif # ARCH_CHIP_QEMU
endif # ARCH_X86_64
```

## arch/x86_64/src/jailhouse/Kconfig
```kconfig
#
# For a description of the syntax of this configuration file,
# see the file kconfig-language.txt in the NuttX tools repository.
#

if ARCH_CHIP_JAILHOUSE
comment "JAILHOUSE Configuration Options"

config JAILHOUSE_KEYPAD
	bool "JAILHOUSE Keypad"
	default n
	---help---
		Enable support for the JAILHOUSE keypad.  See jailhouse_keypad.h for
		interfaces.

config JAILHOUSE_VGA
	bool "JAILHOUSE VGA"
	default n
	---help---
		Enable support for the JAILHOUSE VGA.  See jailhouse_vga.h for interfaces.

		NOTE:  This VGA driver exports a character driver that can be used
		to write into the VGA framebuffer. It does *NOT* support a NuttX
		framebuffer interfaces and, hence, cannot be used with the NuttX
		graphics subsystem.  Such a conversion to the standard NuttX
		framebuffer interface would, however, not be a big job.

config JAILHOUSE_GPIOIRQ
	bool "GPIO interrupt support"
	default n
	depends on EXPERIMENTAL
	---help---
		Enable support for GPIO interrupts (not implemented)

endif
```

## configs/qemu-intel64/ostest/defconfig
```kconfig
CONFIG_ARCH_BOARD_QEMU_INTEL64=y
CONFIG_ARCH_BOARD="qemu-intel64"
CONFIG_ARCH_CHIP_QEMU=y
CONFIG_ARCH_STACKDUMP=y
CONFIG_ARCH_X86_64=y
CONFIG_ARCH="x86_64"
CONFIG_BOARD_LOOPSPERMSEC=999
CONFIG_BOOT_RUNFROMEXTSRAM=y
CONFIG_DEV_LOWCONSOLE=y
CONFIG_DISABLE_POLL=y
CONFIG_EXAMPLES_OSTEST_LOOPS=100
CONFIG_EXAMPLES_OSTEST_STACKSIZE=4096
CONFIG_EXAMPLES_OSTEST=y
CONFIG_FS_FAT=y
CONFIG_IDLETHREAD_STACKSIZE=262144
CONFIG_USERMAIN_STACKSIZE=262144
CONFIG_PTHREAD_STACK_MIN=2048
CONFIG_PTHREAD_STACK_DEFAULT=131072
CONFIG_MAX_TASKS=64
CONFIG_NFILE_DESCRIPTORS=32
CONFIG_PTHREAD_MUTEX_TYPES=y
CONFIG_RAM_SIZE=1048576
CONFIG_RAM_START=0x00000000
CONFIG_SDCLONE_DISABLE=y
CONFIG_START_DAY=3
CONFIG_START_MONTH=3
CONFIG_START_YEAR=2011
CONFIG_MEMCPY_INDEXED_COPY=y
CONFIG_MEMCPY_64BIT=y
CONFIG_MEMSET_OPTSPEED=y
CONFIG_MEMSET_64BIT=y
CONFIG_USER_ENTRYPOINT="ostest_main"
```
